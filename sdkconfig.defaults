## sdkconfig.defaults
```kconfig
# SPDX-License-Identifier: GPL-2.0-only
# Copyright (C) 2025, Input Labs Oy.
#
# sdkconfig.defaults for esp_llama_ble
# BLE HID device using NimBLE + esp_hidd
#
# Usage: idf.py reconfigure && idf.py build

# Enable Bluetooth
CONFIG_BT_ENABLED=y

# Select NimBLE as the BLE host stack (native for ESP32-C2)
CONFIG_BT_NIMBLE_ENABLED=y

# Disable WiFi / ESPNOW (no longer needed)
CONFIG_ESP_WIFI_ENABLED=n

# Enable NimBLE HID service (required by esp_hidd for HID Device support)
CONFIG_BT_NIMBLE_HID_SERVICE=y

# Allow up to 8 HID report characteristics (keyboard in+out, mouse, gamepad)
CONFIG_BT_NIMBLE_SVC_HID_MAX_RPTS=8

# Optimize NimBLE for single peripheral connection
CONFIG_BT_NIMBLE_MAX_CONNECTIONS=1
```
